// SPDX-License-Identifier: GPL-2.0
// Copyright (c) 2020 Fii USA Inc. 
// Maintainer: Brandon Ong <Brandon.Ong@fii-na.com>

/dts-v1/;
#include "nuvoton-npcm730.dts"
#include "nuvoton-npcm7xx-pinctrl.dtsi"
#include "nuvoton-npcm730-kudo-pincfg.dtsi"

/ {
	model = "Fii npcm730 BMC Board (Device Tree v00.07)";
	compatible = "nuvoton,poleg", "kudo";

    pinctrl: pinctrl@f0800000 {
        compatible = "nuvoton,npcm7xx-pinctrl";
        pinctrl-names = "default";
        pinctrl-0 = <
                &gpio32ol_pins
                &gpio37i_pins
                &gpio38i_pins
                &gpio39i_pins
                &gpio40i_pins
                &gpio41i_pins
                &gpio42oh_pins
                &gpio43i_pins
                &gpio48oh_pins
                &gpio49i_pins
                &gpio50i_pins
                &gpio51oh_pins
                &gpio52i_pins
                &gpio53oh_pins
                &gpio54i_pins
                &gpio55ol_pins
                &gpio61oh_pins
                &gpio62oh_pins
                &gpio63oh_pins
                &gpio64oh_pins
                &gpio65ol_pins
                &gpio66oh_pins
                &gpio67oh_pins
                &gpio68ol_pins
                &gpio69i_pins
                &gpio70ol_pins
                &gpio71i_pins
                &gpio72i_pins
                &gpio73i_pins
                &gpio74i_pins
                &gpio75i_pins
                &gpio76i_pins
                &gpio77i_pins
                &gpio78i_pins
                &gpio79ol_pins
                &gpio80oh_pins
                &gpio81i_pins
                &gpio82i_pins
                &gpio83i_pins
                &gpio95i_pins
                &gpio120i_pins
                &gpio121i_pins
                &gpio122i_pins
                &gpio123i_pins
                &gpio124i_pins
                &gpio125i_pins
                &gpio126i_pins
                &gpio127i_pins
                &gpio136i_pins
                &gpio137oh_pins
                &gpio138i_pins
                &gpio139i_pins
                &gpio140i_pins
                &gpio141i_pins
                &gpio144i_pins
                &gpio145i_pins
                &gpio146i_pins
                &gpio147oh_pins
                &gpio161ol_pins
                &gpio162oh_pins
                &gpio163i_pins
                &gpio167ol_pins
                &gpio168ol_pins
                &gpio169oh_pins
                &gpio170ol_pins
                &gpio175oh_pins
                &gpio176ol_pins
                &gpio177i_pins
                &gpio190oh_pins
                &gpio191oh_pins
                &gpio194oh_pins
                &gpio195ol_pins
                &gpio196ol_pins
                &gpio197oh_pins
                &gpio199i_pins
                &gpio202ol_pins
                &gpio203ol_pins
                &gpio218oh_pins
                &gpio219oh_pins
                >;
	};
